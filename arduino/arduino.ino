#include <ESP8266WiFi.h>
#include <ESP8266WebServer.h>
#include <time.h>
#include <EEPROM.h>

// Wi-Fi
const char *ssid = "";
const char *password = "";

const char PAGE_SAVED_TPL[] PROGMEM = R"rawliteral(
<!DOCTYPE html>
<html lang="en">
<head>
  <meta charset="UTF-8" />
  <meta name="viewport" content="width=device-width, initial-scale=1.0" />
  <title>%s</title>
  <style>
    body {
      font-family: Arial, sans-serif;
      background-color: #fefefe;
      color: #171321;
      margin: 0;
      padding: 0;
      display: flex;
      flex-direction: column;
      align-items: center;
      justify-content: center;
      height: 100vh;
      text-align: center;
    }
    h1 { font-size: 2rem; margin-bottom: 1rem; }
    a  {
      font-size: 1rem;
      color: #ffffff;
      background-color: #44803f;
      padding: 10px 20px;
      text-decoration: none;
      border-radius: 5px;
      transition: background-color 0.3s ease;
    }
    a:hover { background-color: #234720; }
  </style>
</head>
<body>
  <h1>%s</h1>
  <a href="/">Return</a>
</body>
</html>
)rawliteral";


const uint8_t faviconData[] PROGMEM = {
    0x00, 0x00, 0x01, 0x00, 0x03, 0x00, 0x10, 0x10, 0x00, 0x00, 0x01, 0x00,
    0x20, 0x00, 0x68, 0x04, 0x00, 0x00, 0x36, 0x00, 0x00, 0x00, 0x20, 0x20,
    0x00, 0x00, 0x01, 0x00, 0x20, 0x00, 0x28, 0x11, 0x00, 0x00, 0x9e, 0x04,
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    0x00, 0x00, 0x00, 0x00, 0x00, 0x00, 0x00, 0x00, 0x00, 0x00};


struct DayConfig {
  bool enable;
  int duration;
  char time[6]; // "HH:mm\0"
};

DayConfig irrigationConfig[31];

// Configuração de fuso horário (Horário de Brasília)
const char *ntpServer = "pool.ntp.org";
const long gmtOffset_sec = -10800; // UTC-3
const int daylightOffset_sec = 0;

// Pino de saída
int pinOutput = D7;

// WebServer na porta 80
ESP8266WebServer server(80);



void initializeDefaultConfig()
{
  for (int i = 0; i < 31; i++)
  {
    irrigationConfig[i].enable = true;
    irrigationConfig[i].duration = 120;
    strcpy(irrigationConfig[i].time, "06:30");
  }
}

void clearEEPROM()
{
  for (int i = 0; i < EEPROM.length(); i++)
  {
    EEPROM.write(i, 0);
  }
  EEPROM.commit();
  Serial.println("EEPROM cleared!");
}

void saveConfigToEEPROM() {
  for (int i = 0; i < 31; i++) {
    int addr = i * sizeof(DayConfig);
    EEPROM.put(addr, irrigationConfig[i]);
  }
  EEPROM.commit();
}

void loadConfigFromEEPROM() {
  for (int i = 0; i < 31; i++) {
    int addr = i * sizeof(DayConfig);
    DayConfig tempConfig;
    EEPROM.get(addr, tempConfig);

    if (tempConfig.duration > 0 && tempConfig.duration <= 3600 && strlen(tempConfig.time) == 5 && tempConfig.time[2] == ':') {
        irrigationConfig[i] = tempConfig;
    } else {
        irrigationConfig[i].enable = true;
        irrigationConfig[i].duration = 120;
        strcpy(irrigationConfig[i].time, "06:30");
    }
  }
}
void handleFavicon()
{
  server.send_P(200, "image/x-icon", (const char *)faviconData, sizeof(faviconData));
}

void setup()
{
  EEPROM.begin(2048);

  initializeDefaultConfig(); // Define configurações padrão
  loadConfigFromEEPROM();

  pinMode(pinOutput, OUTPUT);
  digitalWrite(pinOutput, LOW);

  Serial.begin(115200);
  Serial.println();
  Serial.println("Starting...");

  WiFi.begin(ssid, password);
  Serial.print("connecting to Wi-Fi");
  while (WiFi.status() != WL_CONNECTED)
  {
    delay(1000);
    Serial.print(".");
  }
  Serial.println("\nConnected!");
  Serial.print("IP Address: ");
  Serial.println(WiFi.localIP());

  configTime(gmtOffset_sec, daylightOffset_sec, ntpServer);
  Serial.println("Synchronizing with NTP...");
  atualizarHora();

  server.on("/", handleRoot);
  server.on("/update", handleUpdate);
  server.on("/irrigate", handleIrrigate);
  server.on("/favicon.ico", handleFavicon);
  server.begin();
  Serial.println("Web server started!");
}

void atualizarHora()
{
  time_t now = time(NULL);
  while (now < 8 * 3600 * 2)
  {
    Serial.println("Waiting for time synchronization...");
    delay(1000);
    now = time(NULL);
  }
  struct tm *timeInfo = localtime(&now);
  Serial.print("Synchronized time: ");
  Serial.println(asctime(timeInfo));
}

String buildSavedPage(const char* title)
{
  static char buf[2048];
  snprintf_P(buf, sizeof(buf), PAGE_SAVED_TPL, title, title);
  return String(buf);
}


void handleRoot()
{
  String html = R"rawliteral(
<!DOCTYPE html>
<html lang="en">
  <head>
    <meta charset="UTF-8" />
    <meta name="viewport" content="width=device-width, initial-scale=1.0" />
     <link rel="icon" href="/favicon.ico" type="image/x-icon" />
    <title> Open Irrigation</title>
      <style>
      :root {
        --black: #171321;
        --white: #fefefe;

        --color-1: #234720;
        --color-2: #ffec5c;
        --color-3: #bdaa1a;
        --color-4: #ff5a33;
        --color-5: #9f341c;
        --color-6: #44803f;
        --color-8: #44803f44;

        /* navbar */
        --navbar-color: var(--color-6);
        --navbar-text-color: var(--white);
        /* table */
        --table-color: var(--color-6);
        --table-text-color: var(--white);
        --table-border: var(--color-8);
        /* button */
        --button-color: var(--color-6);
        --button-hover-color: var(--color-1);
        --button-text-color: var(--white);

        --base-size: 1rem;
        --scale: 1.15;
        --h6: calc(var(--base-size) * var(--scale));
        --h5: calc(var(--h6) * var(--scale));
        --h4: calc(var(--h5) * var(--scale));
        --h3: calc(var(--h4) * var(--scale));
        --h2: calc(var(--h3) * var(--scale));
        --h1: calc(var(--h2) * var(--scale));

        @media screen and (width < 910px) {
          --base-size: 0.9rem;
        }

        @media screen and (width < 400px) {
          --base-size: 0.85rem;
        }
      }

      *,
      *::after,
      *::before {
        box-sizing: inherit;
        margin: 0;
        padding: 0;
      }

      html {
        box-sizing: border-box;
        font-size: var(--base-size);
      }

      body {
        margin: 0;
        padding: 0;
        font-family: Arial, sans-serif;
        background-color: var(--white);
        font-size: var(--base-size);
        color: var(--black);
    
      }
      header{
        background-color: var(--navbar-color);
      }

      header nav {
        max-width: 1270px;
        margin-left: auto;
        margin-right: auto;
        color: var(--navbar-text-color);
        padding: 1rem;
        display:flex;
        justify-content: space-between;
      }

      main {
        padding:  2rem 1rem;
        max-width: 1270px;
        margin-left: auto;
        margin-right: auto;
      }

      main  {
        padding-top: 2rem;
      }

      h1 {
        font-size: var(--h1);
      }

      h2 {
        font-size: var(--h2);
      }

      h3 {
        font-size: var(--h3);
      }

      h4 {
        font-size: var(--h4);
      }

      h5 {
        font-size: var(--h5);
      }

      h6 {
        font-size: var(--h6);
      }

      .day {
        margin: 5px 0;
        padding: 10px;
        background: #e8e8ee;
        border-radius: 5px;
      }
      .day input {
        margin-left: 10px;
      }

      button {
        background: var(--button-color);
        color: var(--button-text-color);
        font-size: var(--base-size);
        padding: 10px;
        border: none;
        border-radius: 5px;
        cursor: pointer;
      }
      button:hover {
        background: var(--button-hover-color);
      }

      table {
        width: 100%;
        border-collapse: collapse;
        border-radius: 4px;
        overflow: hidden;
      }

      th,
      td {
        padding: 10px;
        border: 1px solid #ddd;
        text-align: center;
        position: relative;
        border: none;
        font-size: var(--base-size);
      }

      th {
        background: var(--table-color);
        color: var(--table-text-color);
        vertical-align: baseline;
      }

      td {
        border-right: 1px solid var(--table-border);
      }

      td:last-of-type {
        border: none;
      }

      tr:nth-child(even) {
        background: #f2f2f2;
      }

      td input {
        height: 2rem;

        @media only screen and (width < 910px) {
          width: 100%;
        }
      }

      td label {
        width: 100%;
        height: 100%;
        display: block;
        position: absolute;
        cursor: pointer;
        top: 0;
        left: 0;
      }

      input[type="checkbox"] {
        width: 20px;
        height: 20px;
      }

      /* Chrome, Safari, Edge, Opera */
      input::-webkit-outer-spin-button,
      input::-webkit-inner-spin-button {
        -webkit-appearance: none;
        margin: 0;
      }

      /* Firefox */
      input[type="number"] {
        -moz-appearance: textfield;
      }


      #reset-configs {
        --button-color: var(--color-4);
        /* --button-text-color: var(--black); */
        --button-hover-color: var(--color-5);
      }

      .actions {
        display: flex;
        justify-content: center;
        align-items: center;
        gap: 1rem;
        padding-top: 2rem;
      }

      .actions button {
        width: 100%;
        margin-bottom: 0.5rem;
        @media only screen and (width > 910px) {
          width: 200px;
        }
      }

      .visually-hidden {
        clip: rect(0 0 0 0);
        clip-path: inset(50%);
        height: 1px;
        overflow: hidden;
        position: absolute;
        white-space: nowrap;
        width: 1px;
      }
    </style>
  </head>
  <body>
    <header>
      <nav>
        <h1>Open Irrigation</h1>
        <form action="/irrigate" method="GET">
          <button id="irrigate-now" type="submit" style="background-color: #c34614;">
            Irrigate now (30s)
          </button>
        </form>
      </nav>
    </header>
    <main>
      <form action="/update" method="GET">
        <table>
          <caption class="visually-hidden">
            Irrigation control
          </caption>
          <tr>
            <th scope="col">Day</th>
            <th scope="col">Activate</th>
            <th scope="col">Duration (s)</th>
            <th scope="col">Time</th>
          </tr>
)rawliteral";

  for (int i = 0; i < 31; i++)
  {
    html += "<tr>";

    html += "<td row='Day configuration " + String(i + 1) + "'>" + String(i + 1) + "</td>";

    html += "<td>";
    html += "<label for='cb-" + String(i + 1) + "'> </label>";
    html += "<input id='cb-" + String(i + 1) + "' type='checkbox' name='enable" + String(i) + "'";
    if (irrigationConfig[i].enable)
    {
      html += " checked";
    }
    html += ">";
    html += "</td>";

    html += "<td>";
    html += "<label for='ip-duration-" + String(i + 1) + "' class='visually-hidden'>";
    html += "Enter the irrigation time, in seconds";
    html += "</label>";
    html += "<input id='ip-duration-" + String(i + 1) + "' type='number' name='duration" + String(i) + "' ";
    html += "value='" + String(irrigationConfig[i].duration) + "'>";
    html += "</td>";

    // Input para horário
    html += "<td>";
    html += "<label for='ip-time-" + String(i + 1) + "' class='visually-hidden'>";
    html += "Enter the time you want to turn on the irrigation, separate hours from minutes using :";
    html += "</label>";
    html += "<input id='ip-time-" + String(i + 1) + "' type='time' name='time" + String(i) + "' ";
    html += "value='" + String(irrigationConfig[i].time) + "'>";
    html += "</td>";

    html += "</tr>";
  }

  html += R"rawliteral(
        </table>
          <div class="actions">
          <button id="save-configs" type="submit">Save Configs</button>
        </div>
      </form>
    
    </main>
  </body>
</html>
)rawliteral";

  server.send(200, "text/html", html);
}

void handleUpdate() {
    for (int i = 0; i < 31; i++) {
        String enableParam = "enable" + String(i);
        String durationParam = "duration" + String(i);
        String timeParam = "time" + String(i);

        // Atualiza o estado "enable"
        irrigationConfig[i].enable = server.hasArg(enableParam) ;

        // Valida e atualiza "duration"
        if (server.hasArg(durationParam)) {
            int durationValue = server.arg(durationParam).toInt();
            if (durationValue > 0 && durationValue <= 3600) {
                irrigationConfig[i].duration = durationValue;
            } else {
                irrigationConfig[i].duration = 120; // Valor padrão
            }
        } else {
            irrigationConfig[i].duration = 120; // Valor padrão
        }

        // Valida e atualiza "time"
        if (server.hasArg(timeParam)) {
            String timeValue = server.arg(timeParam);
            if (timeValue.length() == 5 && timeValue[2] == ':' && 
                isDigit(timeValue[0]) && isDigit(timeValue[1]) && 
                isDigit(timeValue[3]) && isDigit(timeValue[4])) {
                strcpy(irrigationConfig[i].time, timeValue.c_str());
            } else {
                strcpy(irrigationConfig[i].time, "06:30"); // Valor padrão
            }
        } else {
            strcpy(irrigationConfig[i].time, "06:30"); // Valor padrão
        }

    }

    saveConfigToEEPROM();

  String html = buildSavedPage("Settings Saved");
  server.send(200, "text/html", html);
}


void handleIrrigate() {
  irrigateNow(30);
  String html = buildSavedPage("Irrigation started!");
  server.send(200, "text/html", html);
}


void irrigateNow(int time){
      Serial.println("turning on the irrigation output...");
      digitalWrite(pinOutput, HIGH);
      delay(time * 1000);
      digitalWrite(pinOutput, LOW);
      Serial.println("turning off the irrigation output...");
}

void loop()
{
  server.handleClient();

  time_t now = time(NULL);
  struct tm *timeInfo = localtime(&now);
  if (timeInfo != NULL)
  {
    int dayOfMonth = timeInfo->tm_mday - 1;
    String currentTime = (timeInfo->tm_hour < 10 ? "0" : "") + String(timeInfo->tm_hour) + ":" + (timeInfo->tm_min < 10 ? "0" : "") + String(timeInfo->tm_min);

    if (irrigationConfig[dayOfMonth].enable && irrigationConfig[dayOfMonth].duration > 0 && String(irrigationConfig[dayOfMonth].time) == currentTime && timeInfo->tm_sec == 0)
    {
      irrigateNow(irrigationConfig[dayOfMonth].duration);
    }
  }
}
